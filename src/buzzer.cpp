#include "buzzer.h"
#include "config.h"
#include <buzzer_sequencer.h>

static BuzzerSequencer sequencer;  // Beep timing
static bool active = false;        // A sequence was started and not reset yet: avoid retriggering

// Tone is generated by Timer1 in CTC mode, toggling OC1A (D9) in hardware.
// No interrupts involved, so FastLED.show() (interrupts off) can't distort the tone.
static void toneOn() {
  OCR1A = F_CPU / (2UL * 8 * BEEP_TONE) - 1;
  TCNT1 = 0;
  TCCR1A = _BV(COM1A0);              // Toggle OC1A on compare match
  TCCR1B = _BV(WGM12) | _BV(CS11);   // CTC, prescaler 8
}

static void toneOff() {
  TCCR1A = 0;
  TCCR1B = 0;
  PORTB &= ~_BV(PORTB1);             // Keep buzzer pin low
}

// Carry out what the beep sequencer asked for. True if the pattern is over.
static bool apply(const BuzzerEvent& e) {
  if (e.setTone) {
    if (e.tone) toneOn();
    else toneOff();
  }
  return e.finished;
}

void buzzerBegin() {
  pinMode(PIN_BUZZER, OUTPUT);
  buzzerReset();
}

bool buzzerUpdate() {
  return apply(sequencerTick(sequencer, millis()));
}

void runBuzzer(BuzzerMode mode) {
  if (active) return;
  apply(sequencerStart(sequencer, (mode == BUZZER_TIMER) ? TIMER_BEEP : ALARM_BEEP, millis()));
  active = true;
}

void buzzerStop() {
  sequencerStop(sequencer);
  toneOff();
}

void buzzerReset() {
  buzzerStop();
  active = false;
}
